## CMakeLists.txt
```
cmake_minimum_required(VERSION 3.20.0)
find_package(Zephyr REQUIRED HINTS $ENV{ZEPHYR_BASE})
project(motor_led_node)

add_subdirectory(${CMAKE_CURRENT_LIST_DIR}/../mlmw mlmw)
target_sources(app PRIVATE src/main.c src/plant.c src/net.c src/mac_psa.c)
target_link_libraries(app PRIVATE mlmw)
```

## prj.conf
```kconfig
# Motor + LED node on mps2/an521/cpu0/ns: Zephyr in the non-secure world,
# TF-M (PSA Crypto, Internal Trusted Storage) in the secure world.
CONFIG_MAIN_STACK_SIZE=4096
CONFIG_HEAP_MEM_POOL_SIZE=16384

CONFIG_BUILD_WITH_TFM=y
CONFIG_TFM_PARTITION_CRYPTO=y
CONFIG_TFM_PARTITION_INTERNAL_TRUSTED_STORAGE=y

CONFIG_NETWORKING=y
CONFIG_NET_IPV4=y
CONFIG_NET_IPV6=n
CONFIG_NET_UDP=y
CONFIG_NET_TCP=n
CONFIG_NET_SOCKETS=y
CONFIG_NET_L2_ETHERNET=y
CONFIG_NET_CONFIG_SETTINGS=y
CONFIG_NET_CONFIG_NEED_IPV4=y
CONFIG_NET_CONFIG_MY_IPV4_ADDR="10.0.2.15"
CONFIG_NET_CONFIG_MY_IPV4_NETMASK="255.255.255.0"
CONFIG_NET_CONFIG_MY_IPV4_GW="10.0.2.2"
CONFIG_NET_MAX_CONTEXTS=6
CONFIG_ZVFS_OPEN_MAX=8

CONFIG_LOG=y
CONFIG_NET_LOG=y
CONFIG_PRINTK=y

# QEMU user-mode networking on the LAN9118 model (no SLIP / UART pipe)
CONFIG_NET_QEMU_USER=y
CONFIG_UART_PIPE=n
CONFIG_ENTROPY_GENERATOR=y
# 1 ms kernel tick so the 1 kHz control loop really runs at 1 kHz
CONFIG_SYS_CLOCK_TICKS_PER_SEC=1000
```

## boards/mps2_an521_cpu0_ns.overlay
```dts
/* Entropy for the network stack comes from PSA Crypto in TF-M (secure world). */
/ {
	chosen {
		zephyr,entropy = &psa_rng;
	};

	psa_rng: psa-rng {
		compatible = "zephyr,psa-crypto-rng";
		status = "okay";
	};
};
```

## src/main.c
```c
/* Motor + LED node: the mlmw middleware integrated on Zephyr.
 *
 * - control thread, 1 kHz: speed ramp + PI (mlmw), fault monitor, LED mixing;
 *   inside each 1 ms tick the hall "ISR" runs at 20 kHz: hall -> sector ->
 *   six-step gate mask (mlmw), applied to the simulated motor (plant.c)
 * - network thread: authenticated command frames over UDP/Ethernet, checked by
 *   mlmw_cmd_process with the MAC verified by PSA Crypto in TF-M (secure world)
 * - telemetry: one UDP datagram every 100 ms to the last command sender
 */
#include <string.h>

#include <zephyr/kernel.h>
#include <zephyr/sys/byteorder.h>
#include <zephyr/sys/printk.h>

#include "mac_psa.h"
#include "mlmw/bldc.h"
#include "mlmw/cmd.h"
#include "mlmw/led.h"
#include "net.h"
#include "plant.h"

#define SUBSTEPS 20u
#define SUBSTEP_US 50u
#define MAX_RPM 3000
#define RAMP_RPM_PER_MS 5
#define OC_LIMIT_MA 15000u

K_MUTEX_DEFINE(lock);

static struct {
	int16_t target_rpm;
	bool forward;
	int32_t sp;
	uint16_t duty;
	int32_t rpm;
	uint8_t fault;
	uint8_t led_rgb[3];
	uint8_t led_brightness;
	uint16_t led_duty[3];
	int16_t led_temp;
	uint16_t accepted;
	uint16_t rejected;
	int8_t last_status;
	bool clear_req;
} st = {.forward = true};

static mlmw_pi_t pi = {.kp_q15 = 3277, .ki_q15 = 655, .out_min = 0, .out_max = 1000};
static mlmw_fault_t fault;
static const mlmw_led_cal_t led_cal = {{32767, 29491, 26214}, 85, 125, 8192};

static void h_speed(void *u, int16_t rpm)
{
	st.target_rpm = rpm;
}

static void h_stop(void *u)
{
	st.target_rpm = 0;
}

static void h_led(void *u, uint8_t r, uint8_t g, uint8_t b, uint8_t br)
{
	st.led_rgb[0] = r;
	st.led_rgb[1] = g;
	st.led_rgb[2] = b;
	st.led_brightness = br;
}

static void h_clear(void *u)
{
	st.clear_req = true;
}

static const mlmw_cmd_handlers_t handlers = {h_speed, h_stop, h_led, h_clear};
static mlmw_cmd_ctx_t cmd;

static void control_thread(void)
{
	uint32_t now_ms = 0;
	uint32_t since_edge_us = 1000000;
	uint32_t period_us = 0;
	uint8_t last_hall = plant_hall();

	mlmw_fault_init(&fault, OC_LIMIT_MA, 5, 200, 0);
	while (1) {
		k_mutex_lock(&lock, K_FOREVER);
		if (st.clear_req) {
			mlmw_fault_clear(&fault, now_ms);
			mlmw_pi_reset(&pi);
			st.clear_req = false;
		}
		int32_t want = st.target_rpm;
		bool want_fwd = want >= 0;

		/* reverse only after the rotor has come down to (almost) zero */
		if (want_fwd != st.forward) {
			if (st.rpm < 50) {
				st.forward = want_fwd;
				mlmw_pi_reset(&pi);
			}
			want = 0;
		}
		int32_t target_abs = want < 0 ? -want : want;

		st.sp = mlmw_ramp(st.sp, target_abs, RAMP_RPM_PER_MS);
		bool running = st.sp > 0 && st.fault == MLMW_FAULT_NONE;

		if (running) {
			st.duty = (uint16_t)mlmw_pi_step(&pi, st.sp - st.rpm);
		} else {
			st.duty = 0;
			mlmw_pi_reset(&pi);
		}
		bool edge_in_tick = false;
		uint16_t peak_ma = 0;

		for (uint32_t k = 0; k < SUBSTEPS; k++) {
			uint8_t hall = plant_hall();

			if (hall != last_hall) {
				edge_in_tick = true;
				period_us = since_edge_us;
				since_edge_us = 0;
				last_hall = hall;
			}
			since_edge_us += SUBSTEP_US;
			int8_t sector = mlmw_hall_to_sector(hall);
			uint8_t mask = running ? mlmw_commutation(sector, st.forward) : 0u;

			plant_step(mask, st.duty, SUBSTEP_US);
			uint16_t ma = plant_current_ma();

			peak_ma = ma > peak_ma ? ma : peak_ma;
		}
		st.rpm = since_edge_us > 100000u ? 0 : (int32_t)mlmw_speed_rpm(period_us, PLANT_POLE_PAIRS);
		st.fault = mlmw_fault_update(&fault, peak_ma, now_ms, edge_in_tick, running && st.duty > 0);

		plant_led_step(st.led_duty, 1000);
		if (now_ms % 100u == 0u) {
			st.led_temp = plant_led_temp_c();
			mlmw_led_mix(&led_cal, st.led_rgb, st.led_brightness, st.led_temp, st.led_duty);
		}
		k_mutex_unlock(&lock);
		now_ms++;
		k_msleep(1);
	}
}

static void telemetry(uint32_t t_ms)
{
	uint8_t b[24];

	k_mutex_lock(&lock, K_FOREVER);
	b[0] = 'T';
	sys_put_be32(t_ms, &b[1]);
	sys_put_be16((uint16_t)st.target_rpm, &b[5]);
	sys_put_be16((uint16_t)(st.forward ? st.rpm : -st.rpm), &b[7]);
	sys_put_be16(st.duty, &b[9]);
	b[11] = st.fault;
	sys_put_be16((uint16_t)st.led_temp, &b[12]);
	sys_put_be16(st.led_duty[0], &b[14]);
	sys_put_be16(st.led_duty[1], &b[16]);
	sys_put_be16(st.led_duty[2], &b[18]);
	sys_put_be16(st.accepted, &b[20]);
	sys_put_be16(st.rejected, &b[22]);
	k_mutex_unlock(&lock);
	net_reply(b, sizeof(b));
}

static void network_thread(void)
{
	uint8_t buf[64];
	uint32_t next_tlm = 0;

	while (1) {
		int n = net_recv(buf, sizeof(buf), 10);

		if (n > 0) {
			k_mutex_lock(&lock, K_FOREVER);
			int s = mlmw_cmd_process(&cmd, buf, (size_t)n);

			st.last_status = (int8_t)s;
			if (s == MLMW_OK) {
				st.accepted++;
			} else {
				st.rejected++;
			}
			k_mutex_unlock(&lock);
			uint8_t ack[4] = {'A', n > 2 ? buf[1] : 0, n > 2 ? buf[2] : 0, (uint8_t)s};

			net_reply(ack, sizeof(ack));
		}
		uint32_t t = k_uptime_get_32();

		if (t >= next_tlm) {
			telemetry(t);
			next_tlm = t + 100;
		}
	}
}

K_THREAD_DEFINE(ctl, 2048, control_thread, NULL, NULL, NULL, 5, 0, 100);

int main(void)
{
	plant_init();
	int rc = mac_psa_init();

	printk("motor-led node: mlmw on %s, PSA key status %d\n", CONFIG_BOARD_TARGET, rc);
	mlmw_cmd_init(&cmd, mac_psa_verify, &handlers, NULL, MAX_RPM);
	if (net_open() != 0) {
		printk("socket failed\n");
		return 0;
	}
	printk("listening on udp/%d\n", NODE_UDP_PORT);
	network_thread();
	return 0;
}
```

## src/mac_psa.c
```c
#include "mac_psa.h"

#include <psa/crypto.h>
#include <zephyr/sys/printk.h>

/* Persistent key id in TF-M Internal Trusted Storage. The non-secure side only
 * ever holds this id. DEMO ONLY: on first boot the key is imported from the
 * constant below; a product would provision it at end of line instead. */
#define CMD_KEY_ID ((psa_key_id_t)0x00001001)
#define CMD_ALG PSA_ALG_TRUNCATED_MAC(PSA_ALG_CMAC, 8)

static const uint8_t demo_key[16] = "mlmw-demo-key-01";

int mac_psa_init(void)
{
	psa_key_attributes_t attr = PSA_KEY_ATTRIBUTES_INIT;
	psa_status_t st = psa_crypto_init();

	if (st != PSA_SUCCESS) {
		return (int)st;
	}
	st = psa_get_key_attributes(CMD_KEY_ID, &attr);
	psa_reset_key_attributes(&attr);
	if (st == PSA_SUCCESS) {
		printk("mac: key 0x%x already in secure storage\n", (unsigned)CMD_KEY_ID);
		return 0;
	}
	psa_key_id_t id;

	psa_set_key_id(&attr, CMD_KEY_ID);
	psa_set_key_lifetime(&attr, PSA_KEY_LIFETIME_PERSISTENT);
	psa_set_key_usage_flags(&attr, PSA_KEY_USAGE_VERIFY_MESSAGE);
	psa_set_key_algorithm(&attr, CMD_ALG);
	psa_set_key_type(&attr, PSA_KEY_TYPE_AES);
	psa_set_key_bits(&attr, 128);
	st = psa_import_key(&attr, demo_key, sizeof(demo_key), &id);
	printk("mac: imported key 0x%x into secure storage, status %d\n", (unsigned)id, (int)st);
	return st == PSA_SUCCESS ? 0 : (int)st;
}

int mac_psa_verify(void *user, const uint8_t *msg, size_t len, const uint8_t tag[8])
{
	(void)user;
	return psa_mac_verify(CMD_KEY_ID, CMD_ALG, msg, len, tag, 8) == PSA_SUCCESS ? 0 : -1;
}
```

## src/mac_psa.h
```c
#ifndef MAC_PSA_H
#define MAC_PSA_H

#include <stddef.h>
#include <stdint.h>

/* Opens (first boot: imports) the command key in TF-M and returns 0 on success. */
int mac_psa_init(void);
/* mlmw_mac_verify_fn: AES-128 CMAC truncated to 8 bytes, verified in the secure world. */
int mac_psa_verify(void *user, const uint8_t *msg, size_t len, const uint8_t tag[8]);

#endif
```

## src/net.c
```c
#include "net.h"

#include <zephyr/net/socket.h>

static int sock = -1;
static struct sockaddr peer;
static socklen_t peer_len;

int net_open(void)
{
	struct sockaddr_in a = {
		.sin_family = AF_INET,
		.sin_port = htons(NODE_UDP_PORT),
		.sin_addr.s_addr = htonl(INADDR_ANY),
	};

	sock = zsock_socket(AF_INET, SOCK_DGRAM, IPPROTO_UDP);
	if (sock < 0) {
		return -1;
	}
	return zsock_bind(sock, (struct sockaddr *)&a, sizeof(a));
}

int net_recv(uint8_t *buf, size_t cap, int timeout_ms)
{
	struct zsock_pollfd p = {.fd = sock, .events = ZSOCK_POLLIN};

	if (zsock_poll(&p, 1, timeout_ms) <= 0) {
		return -1;
	}
	struct sockaddr from;
	socklen_t fl = sizeof(from);
	int n = zsock_recvfrom(sock, buf, cap, 0, &from, &fl);

	if (n >= 0) {
		peer = from;
		peer_len = fl;
	}
	return n;
}

void net_reply(const uint8_t *buf, size_t len)
{
	if (peer_len != 0) {
		zsock_sendto(sock, buf, len, 0, &peer, peer_len);
	}
}
```

## src/net.h
```c
#ifndef NET_H
#define NET_H

#include <stddef.h>
#include <stdint.h>

#define NODE_UDP_PORT 5555

int net_open(void);
/* Blocking receive with timeout; returns length or a negative value. */
int net_recv(uint8_t *buf, size_t cap, int timeout_ms);
/* Send to the peer of the last received datagram (no-op before the first one). */
void net_reply(const uint8_t *buf, size_t len);

#endif
```

## src/plant.c
```c
#include "plant.h"

#include "mlmw/bldc.h"

/* Torque is produced only when the applied gate pair matches the rotor sector:
 * the forward pair for the sector drives forward, the reverse pair drives backward,
 * any other pattern gives no torque. Enough to show whether commutation is right. */
static float theta_e;  /* electrical angle, degrees [0, 360) */
static float omega_e;  /* electrical speed, degrees per second */
static float load;
static float current_a;
static float led_temp = 25.0f;

/* tiny float helpers: the minimal libc used with TF-M has no libm */
static float fabsf_(float x)
{
	return x < 0.0f ? -x : x;
}

static float signf_(float x)
{
	return x < 0.0f ? -1.0f : 1.0f;
}

static const uint8_t hall_of_sector[6] = {1, 3, 2, 6, 4, 5};

#define K_TORQUE 9.0e5f /* deg/s^2 at full duty */
#define DAMPING 18.75f  /* 1/s: full duty settles near 4000 rpm */

void plant_init(void)
{
	theta_e = 10.0f;
	omega_e = 0.0f;
	load = 0.0f;
	current_a = 0.0f;
}

void plant_set_load(float l)
{
	load = l;
}

static int sector(void)
{
	return (int)(theta_e / 60.0f) % 6;
}

void plant_step(uint8_t gate_mask, uint16_t duty_pm, uint32_t dt_us)
{
	float dt = (float)dt_us * 1e-6f;
	float duty = (float)duty_pm / 1000.0f;
	int s = sector();
	float drive = 0.0f;

	if (gate_mask != 0u && gate_mask == mlmw_commutation((int8_t)s, true)) {
		drive = 1.0f;
	} else if (gate_mask != 0u && gate_mask == mlmw_commutation((int8_t)s, false)) {
		drive = -1.0f;
	}
	float acc = K_TORQUE * duty * drive - DAMPING * omega_e;

	if (fabsf_(omega_e) < 1.0f && fabsf_(acc) <= load) {
		acc = 0.0f;
		omega_e = 0.0f;
	} else {
		acc -= load * signf_(omega_e != 0.0f ? omega_e : acc);
	}
	omega_e += acc * dt;
	theta_e += omega_e * dt;
	while (theta_e >= 360.0f) {
		theta_e -= 360.0f;
	}
	while (theta_e < 0.0f) {
		theta_e += 360.0f;
	}
	/* phase current: duty times back-EMF headroom, 20 A at stall and full duty */
	float emf = fabsf_(omega_e) / 60000.0f;

	current_a = 20.0f * duty * (drive != 0.0f ? (1.0f - emf > 0.05f ? 1.0f - emf : 0.05f) : 0.0f);
}

uint8_t plant_hall(void)
{
	return hall_of_sector[sector()];
}

int32_t plant_rpm_true(void)
{
	return (int32_t)(omega_e / 360.0f * 60.0f / (float)PLANT_POLE_PAIRS);
}

uint16_t plant_current_ma(void)
{
	return (uint16_t)(current_a * 1000.0f);
}

void plant_led_step(const uint16_t duty[3], uint32_t dt_us)
{
	float p = ((float)duty[0] + duty[1] + duty[2]) / (3.0f * 65535.0f);
	float t_inf = 25.0f + 110.0f * p;
	float a = (float)dt_us * 1e-6f / 2.0f; /* 2 s thermal time constant */

	led_temp += (t_inf - led_temp) * (a > 1.0f ? 1.0f : a);
}

int16_t plant_led_temp_c(void)
{
	return (int16_t)led_temp;
}
```

## src/plant.h
```c
/* Simplified BLDC motor + LED thermal model, so the node runs without hardware. */
#ifndef PLANT_H
#define PLANT_H

#include <stdint.h>

#define PLANT_POLE_PAIRS 2u

void plant_init(void);
/* Advance by dt_us with the gate mask and duty (0..1000 per mille) applied. */
void plant_step(uint8_t gate_mask, uint16_t duty_pm, uint32_t dt_us);
uint8_t plant_hall(void);
int32_t plant_rpm_true(void);
uint16_t plant_current_ma(void);
/* LED board temperature, driven by the sum of the three PWM duties. */
void plant_led_step(const uint16_t duty[3], uint32_t dt_us);
int16_t plant_led_temp_c(void);
/* Test hook: add a load torque (simulates a blocked rotor when large). */
void plant_set_load(float load);

#endif
```
